## conf/layer.conf
```bitbake
# We have a conf and classes directory, add to BBPATH
BBPATH .= ":${LAYERDIR}"

# We have recipes-* directories, add to BBFILES
BBFILES += "${LAYERDIR}/recipes-*/*/*.bb \
            ${LAYERDIR}/recipes-*/*/*.bbappend"

BBFILE_COLLECTIONS += "meta-grzywas"
BBFILE_PATTERN_meta-grzywas = "^${LAYERDIR}/"
BBFILE_PRIORITY_meta-grzywas = "6"

LAYERDEPENDS_meta-grzywas = "core"
LAYERSERIES_COMPAT_meta-grzywas = "kirkstone"
```
